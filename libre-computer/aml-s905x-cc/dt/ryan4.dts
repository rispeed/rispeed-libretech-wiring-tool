// SPDX-License-Identifier: (GPL-2.0+ OR MIT)
/*
 * Copyright (c) 2022 Da Xue <da@libre.computer>
 * Author: Da Xue <da@libre.computer>
 */

/dts-v1/;
/plugin/;

#include <dt-bindings/gpio/gpio.h>
#include <dt-bindings/gpio/meson-gxl-gpio.h>
#include <dt-bindings/interrupt-controller/irq.h>
#include <dt-bindings/interrupt-controller/amlogic,meson-gxl-gpio-intc.h>

/ {
	compatible = "libretech,cc", "libretech,aml-s905x-cc-v2", "amlogic,s905x", "amlogic,meson-gxl";
	
	fragment@0 {
		target = <&spicc>;
		
		__overlay__ {

			touchscreen@1 {
				compatible = "ti,ads7846";
				reg = <1>;
				spi-max-frequency = <2000000>;
				interrupt-parent = <&gpio_intc>;
				interrupts = <IRQID_GPIOAO_8 IRQ_TYPE_EDGE_FALLING>;
				pendown-gpio = <&gpio_ao GPIOAO_8 GPIO_ACTIVE_LOW>;
				ti,x-min = /bits/ 16 <320>;
				ti,y-min = /bits/ 16 <240>;
				ti,x-max = /bits/ 16 <0x0FFF>;
				ti,y-max = /bits/ 16 <0x0FFF>;
				ti,pressure-min = /bits/ 16 <0>;
				ti,pressure-max = /bits/ 16 <0xFFFF>;
				ti,x-plate-ohms = /bits/ 16 <400>;
				ti,swap-xy = <1>; /* Enable swap_xy */
				wakeup-source;
				status = "okay";
			};
		};
	};
};
