/*
 * Ryans ili9341 on clock select 37
 * Pins 19 (MOSI), 21 (MISO), 23 (CLK), 37 (CS), 29 (DC), 31 (Reset)
 */

/dts-v1/;
/plugin/;

#include <dt-bindings/gpio/gpio.h>
#include <dt-bindings/gpio/meson-gxl-gpio.h>

/ {
	compatible = "libretech,cc", "amlogic,s905x", "amlogic,meson-gxl";

	fragment@0 {
		target = <&cec_AO>;
		
		__overlay__ {
			status = "disabled";
		};
	};
	fragment@1 {
		target = <&spicc>;
		
		__overlay__ {
			/*
			 * - D/C to Pin29 (GPIOX_17)
			 * - RESET to Pin31 (GPIOX_18)
			 * - (LCD) CS to Pin33 (GPIOX_6) (CS0)
			 */
			display@0 {
				compatible = "adafruit,yx240qv29", "ilitek,ili9341";
				rotation = <90>;
				bgr = <0>;
				fps = <15>;
				height = <240>;
				width = <320>;
				debug = <4>;
				reg = <0>;
				buswidth = <8>;
				spi-max-frequency = <30000000>;
				dc-gpios = <&gpio GPIOX_17 GPIO_ACTIVE_HIGH>;
				reset-gpios = <&gpio GPIOX_18 GPIO_ACTIVE_HIGH>;
				status = "okay";
			};
			
						
		};
	};
};