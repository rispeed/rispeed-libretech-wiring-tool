/*
 * Copyright (c) 2017 BayLibre, SAS.
 * Author: Neil Armstrong <narmstrong@baylibre.com>
 *
 * SPDX-License-Identifier: (GPL-2.0+ OR MIT)
 */

/*
 * Overlay aimed to enable SPICC on Header 7J1 :
 * Pins 19 (MOSI), 21 (MISO), 23 (CLK), 24 (SS0)
 */

/dts-v1/;
/plugin/;

#include <dt-bindings/gpio/gpio.h>
#include <dt-bindings/gpio/meson-gxl-gpio.h>

/ {
	compatible = "libretech,cc", "amlogic,s905x", "amlogic,meson-gxl";

	fragment@0 {
		target-path = "/aliases";

		__overlay__ {
			spi0 = "/soc/cbus@c1100000/spi@8d80";
		};
	};

	fragment@1 {
		target = <&spicc>;
		
		__overlay__ {
			status = "okay";
			pinctrl-0 = <&spi_pins>;
			pinctrl-1 = <&spi_pins>, <&spi_idle_high_pins>;
			pinctrl-2 = <&spi_pins>, <&spi_idle_low_pins>;
			pinctrl-names = "default", "idle-high", "idle-low";

			cs-gpios = <&gpio GPIOX_10 GPIO_ACTIVE_LOW>, <&gpio GPIOX_1 GPIO_ACTIVE_LOW>;
		};

	};
    fragment@2 {
                target = <&spicc>;

                __overlay__ {
                        /*
                         * The display signals are connected to :
                         * - SDO(MISO) to Pin21 (SPI_MISO)
                         * - LED/Backlight to Pin2 (5v)
                         * - SCK to Pin23 (SPI_CLK)
                         * - SDI(MOSI) to Pin19 (SPI_MOSI)
                         * - D/C to Pin29 (GPIOX_17)
                         * - RESET to Pin31 (GPIOX_18)
                         * - (LCD) CS to Pin24 (GPIOX_10)
                         * - GND to Pin25 (GND)
                         * - VCC/VIN to Pin17 (3.3V)
                         */
                        display@0 {
                                compatible = "ilitek,ili9341";
                                reg = <2>;
                                height = <320>;
                                width = <240>;
                                rotate = <180>;
                                buswidth = <8>;
                                spi-max-frequency = <41666667>;
                                led-gpios = <&gpio GPIOX_0 GPIO_ACTIVE_HIGH>;
                                dc-gpios = <&gpio GPIOX_17 GPIO_ACTIVE_HIGH>;
                                reset-gpios = <&gpio GPIOX_18 GPIO_ACTIVE_LOW>;
                                status = "okay";
                                cs-gpios = <&gpio GPIOX_5 GPIO_ACTIVE_LOW>;
                        };
                };
        };
};
