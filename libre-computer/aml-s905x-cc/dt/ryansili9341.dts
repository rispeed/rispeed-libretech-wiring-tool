/*
 * Ryans ili9341 on clock select 37
 * Pins 19 (MOSI), 21 (MISO), 23 (CLK), 37 (CS), 29 (DC), 31 (Reset)
 */

/dts-v1/;
/plugin/;

#include <dt-bindings/gpio/gpio.h>
#include <dt-bindings/gpio/meson-gxl-gpio.h>

/ {
	compatible = "libretech,cc", "amlogic,s905x", "amlogic,meson-gxl";

	fragment@0 {
		target = <&spicc>;
		
		__overlay__ {
			/*
			 * The display signals are connected to :
			 * - SDO(MISO) to Pin21 (SPI_MISO)
			 * - LED/Backlight to Pin2 (5v)
			 * - SCK to Pin23 (SPI_CLK)
			 * - SDI(MOSI) to Pin19 (SPI_MOSI)
			 * - D/C to Pin33 (GPIOX_6)
			 * - RESET to Pin35 (GPIOX_7)
			 * - (LCD) CS to Pin37 (GPIOX_5)
			 * - GND to Pin25 (GND)
			 * - VCC/VIN to Pin17 (3.3V)
			 */
			display@0 {
				compatible = "adafruit,yx240qv29", "ilitek,ili9341";
				rotate = <270>;
				rotation = <270>;
				bgr = <0>;
				fps = <15>;
				height = <240>;
				width = <320>;
				debug = <3>;
				reg = <0>;
				buswidth = <8>;
				spi-max-frequency = <30000000>;
				dc-gpios = <&gpio GPIOX_6 GPIO_ACTIVE_HIGH>;
				reset-gpios = <&gpio GPIOX_7 GPIO_ACTIVE_HIGH>;
				status = "okay";
			};
		};
	};
};
